#include "oled_ssd1306.h"
#include "pin_config.h"
#include "driver/gpio.h"
#include "esp_log.h"
#include <string.h>
#include "freertos/FreeRTOS.h"
#include "freertos/task.h"

static const char *TAG = "oled";
#define I2C_TIMEOUT_MS  100

/* Fonte 5x7 — ASCII 32..126 (95 caracteres, 5 bytes cada) */
static const uint8_t font5x7[][5] = {
    {0x00,0x00,0x00,0x00,0x00}, /* 32 space */
    {0x00,0x00,0x5F,0x00,0x00}, /* 33 ! */
    {0x00,0x07,0x00,0x07,0x00}, /* 34 " */
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    {0x08,0x08,0x2A,0x1C,0x08}, /* 126 ~ */
};

/* ---------- Sequência de inicialização ---------- */

static const uint8_t ssd1306_init_cmds[] = {
    0xAE,       /* Display OFF             */
    0xD5, 0x80, /* Clock divide ratio      */
    0xA8, 0x3F, /* Multiplex 64            */
    0xD3, 0x00, /* Display offset 0        */
    0x40,       /* Start line 0            */
    0x8D, 0x14, /* Charge pump enable      */
    0x20, 0x00, /* Horizontal addr mode    */
    0xA1,       /* Segment remap           */
    0xC8,       /* COM scan decrement      */
    0xDA, 0x12, /* COM pins config         */
    0x81, 0xCF, /* Contrast                */
    0xD9, 0xF1, /* Pre-charge period       */
    0xDB, 0x40, /* VCOMH deselect level    */
    0xA4,       /* Display from RAM        */
    0xA6,       /* Normal display (not inv)*/
    0xAF,       /* Display ON              */
};

static esp_err_t send_commands(i2c_master_dev_handle_t dev,
                               const uint8_t *cmds, size_t len)
{
    esp_err_t ret;
    for (size_t i = 0; i < len; i++) {
        uint8_t buf[2] = { 0x00, cmds[i] }; /* Co=0, D/C#=0 (command) */
        ret = i2c_master_transmit(dev, buf, 2, I2C_TIMEOUT_MS);
        if (ret != ESP_OK) { return ret; }
    }
    return ESP_OK;
}

/* ---------- API pública ---------- */

esp_err_t oled_init(oled_handle_t *oled, i2c_master_bus_handle_t bus)
{
    esp_err_t ret;

    /* Reset por hardware */
    gpio_config_t rst_cfg = {
        .pin_bit_mask = 1ULL << OLED_RST_PIN,
        .mode = GPIO_MODE_OUTPUT,
    };
    gpio_config(&rst_cfg);
    gpio_set_level(OLED_RST_PIN, 0);
    vTaskDelay(pdMS_TO_TICKS(10));
    gpio_set_level(OLED_RST_PIN, 1);
    vTaskDelay(pdMS_TO_TICKS(10));

    /* Adiciona dispositivo I2C */
    i2c_device_config_t cfg = {
        .dev_addr_length = I2C_ADDR_BIT_LEN_7,
        .device_address  = OLED_I2C_ADDR,
        .scl_speed_hz    = OLED_I2C_FREQ_HZ,
    };
    ret = i2c_master_bus_add_device(bus, &cfg, &oled->dev);
    if (ret != ESP_OK) {
        ESP_LOGE(TAG, "Falha ao adicionar OLED: %s", esp_err_to_name(ret));
        goto err_add;
    }

    /* Envia sequência de init */
    ret = send_commands(oled->dev, ssd1306_init_cmds, sizeof(ssd1306_init_cmds));
    if (ret != ESP_OK) {
        ESP_LOGE(TAG, "Falha na init do SSD1306: %s", esp_err_to_name(ret));
        goto err_init;
    }

    oled_clear(oled);
    ret = oled_update(oled);
    if (ret != ESP_OK) { goto err_init; }

    ESP_LOGI(TAG, "OLED SSD1306 128x64 inicializado");
    return ESP_OK;

err_init:
    i2c_master_bus_rm_device(oled->dev);
err_add:
    return ret;
}

void oled_clear(oled_handle_t *oled)
{
    memset(oled->framebuf, 0, sizeof(oled->framebuf));
}

esp_err_t oled_update(oled_handle_t *oled)
{
    esp_err_t ret;

    /* Posiciona cursor no início */
    uint8_t pos_cmds[] = { 0x21, 0x00, 0x7F, 0x22, 0x00, 0x07 };
    ret = send_commands(oled->dev, pos_cmds, sizeof(pos_cmds));
    if (ret != ESP_OK) { return ret; }

    /* Envia framebuffer em blocos de 128 bytes (1 página por vez) */
    for (int page = 0; page < OLED_PAGES; page++) {
        uint8_t buf[1 + OLED_WIDTH];
        buf[0] = 0x40; /* Co=0, D/C#=1 (data) */
        memcpy(&buf[1], &oled->framebuf[page * OLED_WIDTH], OLED_WIDTH);
        ret = i2c_master_transmit(oled->dev, buf, sizeof(buf), I2C_TIMEOUT_MS);
        if (ret != ESP_OK) { return ret; }
    }

    return ESP_OK;
}

void oled_draw_text(oled_handle_t *oled, uint8_t x, uint8_t y, const char *text)
{
    if (y >= OLED_PAGES) { return; }

    for (const char *c = text; *c != '\0'; c++) {
        uint8_t ch = (uint8_t)*c;
        if (ch < 32 || ch > 126) { ch = '?'; }

        const uint8_t *glyph = font5x7[ch - 32];
        for (int col = 0; col < 5; col++) {
            if (x + col < OLED_WIDTH) {
                oled->framebuf[y * OLED_WIDTH + x + col] = glyph[col];
            }
        }
        /* 1 pixel de espaçamento entre caracteres */
        if (x + 5 < OLED_WIDTH) {
            oled->framebuf[y * OLED_WIDTH + x + 5] = 0x00;
        }
        x += 6;
        if (x >= OLED_WIDTH) { break; }
    }
}
